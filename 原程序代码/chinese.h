





/*
*使用前请初始化汉字库
*卞新权
*2012.3.8
*/






#include<reg52.h>
#include"hzk16.h"
#include"tftlcd.h"



unsigned char code CHINESE_CHAR8X16[96][16] = //Font8x16
{//按照ASCII编码顺序
//0x08,0x10,0x10,0x00,0x00,0x00,0x00,0x00,0x00,0x00,0x00,0x00,0x00,0x00,0x00,0x00, // columns, rows, num_bytes_per_char
{0x00,0x00,0x00,0x00,0x00,0x00,0x00,0x00,0x00,0x00,0x00,0x00,0x00,0x00,0x00,0x00}, // space 0x20
{0x00,0x00,0x18,0x3C,0x3C,0x3C,0x18,0x18,0x18,0x00,0x18,0x18,0x00,0x00,0x00,0x00}, // !
{0x00,0x63,0x63,0x63,0x22,0x00,0x00,0x00,0x00,0x00,0x00,0x00,0x00,0x00,0x00,0x00}, // "
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{0x00,0x70,0xD8,0xD8,0x70,0x00,0x00,0x00,0x00,0x00,0x00,0x00,0x00,0x00,0x00,0x00}, // DEL

};

//无法正常显示的字符的替代字模
unsigned char code CHINESE_NUL_CHAR[] =          // 数据表
{
//"□", 
		0x00,0x00,0x00,0x00,0x3F,0xFC,0x20,0x04,
      0x20,0x04,0x20,0x04,0x20,0x04,0x20,0x04,
      0x20,0x04,0x20,0x04,0x20,0x04,0x20,0x04,
      0x20,0x04,0x3F,0xFC,0x00,0x00,0x00,0x00
};



/********************************************************************************/
//函数名:tftShowGB
//功  能:显示GB2312汉字及ASCII字串
//参  数:str为要显示的字串
//返回值:
//备  注:外部  GB2312码以大端模式存放
//更  新:2012.3.2									
/********************************************************************************/
void tftShowGB(unsigned char *str)
{
	unsigned char hzTab[32],i;	//存放汉字字模
	while(*str)
	{
		if(*str&0x80)
		{//是汉字
			if(hzk16_gbZiMo(str[0],str[1],hzTab))//获得字模	 str大端模式
			{	//无法获得字模
				for(i=0;i<32;i++)
					hzTab[i]=CHINESE_NUL_CHAR[i];
			}
			tftShowChar(16,16,hzTab);//打字模
			str+=2;//一个汉字两个字节
		}else{//是ASCII码
			if(*str=='\n')
				tftSetCharXY(0,TFT_CHAR_Y+16);
			else
				tftShowChar(8,16,CHINESE_CHAR8X16[*str-32]);//打字模
			str++;
		}
	}
}




/********************************************************************************/
//函数名:tftShowUNI
//功  能:显示UNICODE汉字及字母
//参  数:str为要显示的字串,最后两个字节必须为0
//返回值:
//备  注:外部	,str指向的必须是正确的UNICODE码(每个UNICODE码两个字节)
//			 UNICODE码以小端模式存放
//更  新:2012.3.2									
/********************************************************************************/
void tftShowUNI(unsigned char *str)
{
	unsigned char hzTab[32],i;	//存放汉字字模 若内存小可采用像tmp_buf的方法
	while(str[0]||str[1])//两位不都为0时 是UNICODE码 (两位都为0时 字串结束)
	{
		if(str[1])//高位为0 则是兼容的ASCII码 
		{
			//是汉字
			if(hzk16_uniZiMo(str[1],str[0],hzTab))//获得字模 str小端模式
			{	//无法获得字模
				for(i=0;i<32;i++)
					hzTab[i]=CHINESE_NUL_CHAR[i];
			}
			tftShowChar(16,16,hzTab);//打字模
		}else{
			//是UNICODE字母
			tftShowChar(8,16,CHINESE_CHAR8X16[str[0]-32]);//打字模
		}
		str+=2;//一个字两个字节
	}
}


